## meta-custom/conf/layer.conf
```bitbake
# meta-custom/conf/layer.conf
# This is the custom layer configuration file

BBPATH .= ":${LAYERDIR}"
BBFILES += "${LAYERDIR}/recipes-*/*/*.bb \
	   ${LAYERDIR}/recipes-*/*/*.bbappend \
           ${LAYERDIR}/recipes-rust/*/*.bb"


BBFILE_COLLECTIONS += "custom"
BBFILE_PATTERN_custom = "^${LAYERDIR}/"
BBFILE_PRIORITY_custom = "6"

LAYERDEPENDS_meta-custom = "core"
LAYERSERIES_COMPAT_custom = "kirkstone scarthgap"
```
